## sdkconfig.defaults
```kconfig
# === HARDWARE IDENTITY ===
CONFIG_IDF_TARGET="esp32s3"

# === CPU & CLOCK ===
CONFIG_ESP32S3_DEFAULT_CPU_FREQ_240=y
CONFIG_ESP32S3_DEFAULT_CPU_FREQ_MHZ=240
CONFIG_FREERTOS_HZ=1000
CONFIG_FREERTOS_UNICORE=n                  # Dual-core

# === PSRAM OPTIMIZATION (8MB OPI) ===
CONFIG_SPIRAM=y
CONFIG_SPIRAM_TYPE_AUTO=y
CONFIG_SPIRAM_MODE_OCT=y
CONFIG_SPIRAM_SPEED_80M=y
CONFIG_SPIRAM_BOOT_INIT=y
CONFIG_SPIRAM_USE_MALLOC=y
CONFIG_SPIRAM_MALLOC_ALWAYSINTERNAL=4096  # <4KB stays internal
CONFIG_SPIRAM_MALLOC_RESERVE_INTERNAL=32768
CONFIG_SPIRAM_ALLOW_STACK_EXTERNAL_MEMORY=y
CONFIG_SPIRAM_TRY_ALLOCATE_WIFI_LWIP=y
CONFIG_SPIRAM_ALLOW_BSS_SEG_EXTERNAL_MEMORY=y

# === MEMORY & HEAP ===
CONFIG_HEAP_TLSF_USE_32BIT_PTR=y
CONFIG_HEAP_PLACE_IN_SPIRAM=y              # Primary heap in PSRAM
CONFIG_SPIRAM_MALLOC_RESERVE_INTERNAL=32768

# === DMA MEMORY OPTIMIZATION ===
CONFIG_SPIRAM_ALLOW_MEMSET_NONCACHED=y    # DMA buffers can be in PSRAM
CONFIG_SPI_MASTER_ISR_IN_IRAM=y            # SPI ISR runs in fast IRAM (no stalls)
CONFIG_SPI_SLAVE_ISR_IN_IRAM=y             # SPI slave ISR in IRAM
CONFIG_CACHE_L2_CACHE_SIZE_32KB=y          # L2 cache for DMA coherency
CONFIG_SPI_FLASH_ENABLE_INTEGRITY_CHECK=n # Disable flash integrity check (save 4KB)

# === XIP (CODE EXECUTION FROM PSRAM) ===
CONFIG_SPIRAM_FETCH_INSTRUCTIONS=y         # Allow CPU to fetch code from PSRAM
CONFIG_SPIRAM_RODATA=y                     # Allow read-only data (strings, tables) from PSRAM
CONFIG_SPIRAM_CACHE_WORKAROUND_STRATEGY=MEMW
CONFIG_ESP32S3_INSTRUCTION_CACHE_WRAP=y    # Enable cache wrapping for PSRAM code
CONFIG_ESP32S3_DATA_CACHE_WRAP=y            # Enable cache wrapping for PSRAM data

# === FLASH CONFIGURATION ===
CONFIG_ESPTOOLPY_FLASHMODE_QIO=y
CONFIG_ESPTOOLPY_FLASHFREQ_80M=y
CONFIG_ESPTOOLPY_FLASHSIZE_16MB=y
CONFIG_ESPTOOLPY_FLASHSIZE="16MB"

# === CACHE OPTIMIZATION (Critical for DMA + XIP) ===
CONFIG_ESP32S3_INSTRUCTION_CACHE_32KB=y   # Larger I-cache
CONFIG_ESP32S3_INSTRUCTION_CACHE_LINE_32B=y
CONFIG_ESP32S3_DATA_CACHE_64KB=y           # Larger D-cache
CONFIG_ESP32S3_DATA_CACHE_LINE_64B=y

# === FLASH & PSRAM INTERLEAVE ===
CONFIG_SPIRAM_SPEED=80m
CONFIG_SPIRAM_MEMSET_PATTERN_INIT=y        # Fast PSRAM initialization
CONFIG_SPIRAM_VERIFY_WRITE=y                # Detect PSRAM corruption early

# === PERFORMANCE ===
CONFIG_COMPILER_OPTIMIZATION_DEFAULT=y     # -O2 (balanced)
CONFIG_COMPILER_OPTIMIZATION_ASSERTIONS_ENABLE=y
CONFIG_ESP32S3_BROWNOUT_DET=y
CONFIG_ESP32S3_BROWNOUT_DET_LVL_SEL_7=y
CONFIG_ESP_TASK_WDT_TIMEOUT_S=30

# === WATCHDOG ===
CONFIG_ESP_TASK_WDT=y
CONFIG_ESP_TASK_WDT_CHECK_IDLE_TASK_CPU0=y
CONFIG_ESP_TASK_WDT_CHECK_IDLE_TASK_CPU1=y

# === USB & CONSOLE ===
CONFIG_ESP_CONSOLE_USB_SERIAL_JTAG=y

# === FREERTOS OPTIMIZATION ===
CONFIG_FREERTOS_ENABLE_STATIC_TASK_CLEAN_UP=y
CONFIG_FREERTOS_TICK_TYPE_SYSTICK=y
CONFIG_FREERTOS_SUPPORT_STATIC_ALLOCATION=y
CONFIG_FREERTOS_WATCHPOINT_END_OF_STACK=y  # Detect stack overflow

# === LOGGING ===
CONFIG_LOG_DEFAULT_LEVEL_INFO=y
CONFIG_LOG_MAXIMUM_LEVEL_INFO=y
CONFIG_ESP_SYSTEM_PANIC_PRINT_HALT=y

# === DISABLE UNNECESSARY FEATURES ===
# CONFIG_BLE_MESH is not set
# CONFIG_BT_ENABLED is not set
# CONFIG_WIFI_ENABLED is not set
# CONFIG_ETH_ENABLED is not set
# CONFIG_SPI_FLASH_ENABLE_ENCRYPTED_READ_WRITE is not set
# CONFIG_SECURE_BOOT_ENABLED is not set
# CONFIG_SECURE_BOOT_V2_ENABLED is not set

# === POWER MANAGEMENT ===
CONFIG_PM_ENABLE=y
CONFIG_PM_DFS_INIT_AUTO=y
CONFIG_PM_PROFILING=n
CONFIG_PM_SLP_IRAM_OPT=y                   # Optimize sleep memory

# === INTERNAL RAM PRESERVATION ===
CONFIG_ESP_IPC_USES_CALLERS_PRIORITY=y     # IPC doesn't use extra stack
CONFIG_FREERTOS_PLACE_FUNCTIONS_INTO_FLASH=y  # Move non-critical functions to flash
```
